## camera_stream/main/Kconfig.projbuild
```kconfig
menu "Camera Stream Configuration"

    choice EXAMPLE_PROV_TRANSPORT
        prompt "WiFi provisioning transport"
        default EXAMPLE_PROV_TRANSPORT_BLE

        config EXAMPLE_PROV_TRANSPORT_BLE
            bool "BLE (recommended)"

        config EXAMPLE_PROV_TRANSPORT_SOFTAP
            bool "SoftAP compatibility mode"
    endchoice

    config EXAMPLE_PROV_SOFTAP_PREFIX
        string "Provisioning device name prefix"
        default "Doorbell-"
        help
            The BLE advertisement or SoftAP name is built as
            "<prefix><last 3 MAC bytes>", e.g. Doorbell-4C3408.

    config EXAMPLE_PROV_POP
        string "Provisioning proof-of-possession"
        default "doorbell1234"
        help
            Proof-of-possession string for Security1 provisioning. The App must use
            the same value when sending WiFi credentials over BLE or SoftAP.

    config EXAMPLE_MQTT_BROKER_URI
        string "MQTT broker URI"
        default "mqtt://121.40.131.194:1883"
        help
            URI of the MQTT broker used for doorbell signalling.

    config EXAMPLE_MQTT_USERNAME
        string "MQTT username"
        default "yskj"

    config EXAMPLE_MQTT_PASSWORD
        string "MQTT password"
        default "yskj@123"

    config EXAMPLE_MQTT_CLIENT_ID
        string "MQTT client id"
        default "esp32s3_doorbell"

    config EXAMPLE_DOORBELL_ID
        string "Doorbell device id"
        default "door-001"
        help
            Used to build the MQTT event, command, and retained status topics.

    config EXAMPLE_RELAY_HOST
        string "MJPEG relay host"
        default "114.55.208.72"
        help
            Host/IP of the MJPEG relay (server_relay/mjpeg_relay.py). The board
            pushes JPEG frames to http://<host>:<port>/pub/<doorbell_id>; the App
            views them at http://<host>:<port>/stream/<doorbell_id>.

    config EXAMPLE_RELAY_PORT
        int "MJPEG relay port"
        default 8090
        range 1 65535

    config EXAMPLE_STREAM_TIMEOUT_SEC
        int "Stream inactivity timeout (seconds)"
        default 60
        range 5 600
        help
            The relay push auto-stops this many seconds after the doorbell rings
            unless a hangup command is received first.

    config EXAMPLE_DOORBELL_GPIO
        int "Doorbell button GPIO"
        default 0
        range 0 48
        help
            GPIO connected to the doorbell push button (active low).

endmenu
```

## esp_ble_mesh/provisioner/main/Kconfig.projbuild
```kconfig
menu "Farmely BLE Mesh gateway"

config FARMELY_WIFI_SSID
    string "Wi-Fi SSID (compile-time override; empty = SoftAP provisioning)"
    default ""
    help
        Leave empty (default) to provision Wi-Fi at runtime from the phone app
        over SoftAP. Set a value only for lab/bench builds that must connect to
        a fixed AP without provisioning.

config FARMELY_WIFI_PASSWORD
    string "Wi-Fi password (compile-time override)"
    default ""

config FARMELY_PROV_SOFTAP_PREFIX
    string "SoftAP provisioning name prefix"
    default "Gateway-"
    help
        The SoftAP name is built as "<prefix><last 3 STA MAC bytes>", e.g.
        Gateway-D31548. The app matches this prefix to pick the gateway PoP.

config FARMELY_PROV_POP
    string "Provisioning proof-of-possession"
    default "gateway1234"
    help
        Security1 proof-of-possession. The app must use the same value
        (AppConfig.gatewayProvPop) when provisioning the gateway.

config FARMELY_MQTT_URI
    string "MQTT broker URI"
    default "mqtt://121.40.131.194:1883"

config FARMELY_MQTT_USERNAME
    string "MQTT username"
    default "yskj"

config FARMELY_MQTT_PASSWORD
    string "MQTT password"
    default "yskj@123"

config FARMELY_BENCH_SELF_TEST
    bool "Run BLE Mesh group and directed-control bench test"
    default n
    help
        Runs 20 group OnOff rounds followed by 50 directed OnOff commands
        after confirming at least two saved nodes are online. Enable only
        for an attended hardware bench test.

endmenu
```

## internal_communication/main/Kconfig.projbuild
```kconfig
menu "Example Configuration"

    choice
        bool "Mesh Topology"
        default MESH_TOPO_TREE
        help
            Mesh Network Topology.

        config MESH_TOPO_TREE
            bool "MESH_TOPO_TREE"
        config MESH_TOPO_CHAIN
            bool "MESH_TOPO_CHAIN"
    endchoice

    config MESH_TOPOLOGY
        int
        default 0 if MESH_TOPO_TREE
        default 1 if MESH_TOPO_CHAIN
        help
            Mesh Network Topology.

    config MESH_ENABLE_PS
        bool "Enable mesh PS (power save) function"
        default y
        help
            Enable/Disable Power Save function.

    choice
        bool "Mesh PS device duty cycle type"
        depends on MESH_ENABLE_PS
        default MESH_PS_DEV_DUTY_TYPE_REQUEST
        help
            Mesh PS device duty cycle type.

        config MESH_PS_DEV_DUTY_TYPE_REQUEST
            bool "MESH_PS_DEV_DUTY_TYPE_REQUEST"
        config MESH_PS_DEV_DUTY_TYPE_DEMAND
            bool "MESH_PS_DEV_DUTY_TYPE_DEMAND"
    endchoice

    config MESH_PS_DEV_DUTY_TYPE
        int
        depends on MESH_ENABLE_PS
        default 1 if MESH_PS_DEV_DUTY_TYPE_REQUEST
        default 4 if MESH_PS_DEV_DUTY_TYPE_DEMAND
        help
            Mesh PS device duty cycle type.

    config MESH_PS_DEV_DUTY
        int "Mesh PS device duty cycle"
        depends on MESH_ENABLE_PS
        range 1 100
        default 10
        help
            Mesh PS device duty cycle.

    config MESH_PS_NWK_DUTY
        int "Mesh PS network duty cycle"
        depends on MESH_ENABLE_PS
        range 1 100
        default 10
        help
            Mesh PS network duty cycle.

    config MESH_PS_NWK_DUTY_DURATION
        int "Mesh PS network duty cycle duration (unit: minutes)"
        depends on MESH_ENABLE_PS
        range -1 100
        default -1
        help
            Mesh PS network duty cycle duration.

    choice
        bool "Mesh PS network duty cycle rule"
        depends on MESH_ENABLE_PS
        default MESH_PS_NETWORK_DUTY_APPLIED_ENTIRE
        help
            Mesh PS network duty cycle rule.

        config MESH_PS_NETWORK_DUTY_APPLIED_ENTIRE
            bool "MESH_PS_NETWORK_DUTY_APPLIED_ENTIRE"
        config MESH_PS_NETWORK_DUTY_APPLIED_UPLINK
            bool "MESH_PS_NETWORK_DUTY_APPLIED_UPLINK"
    endchoice

    config MESH_PS_NWK_DUTY_RULE
        int
        depends on MESH_ENABLE_PS
        default 0 if MESH_PS_NETWORK_DUTY_APPLIED_ENTIRE
        default 1 if MESH_PS_NETWORK_DUTY_APPLIED_UPLINK
        help
            Mesh PS network duty cycle rule.

    config MESH_MAX_LAYER
        int "Mesh Max Layer"
        range 1 25 if MESH_TOPO_TREE
        range 1 1000 if MESH_TOPO_CHAIN
        default 6
        help
            Max layer allowed in mesh network.

    config MESH_CHANNEL
        int "channel"
        range 0 14
        default 0
        help
            mesh network channel.

    config MESH_ROUTER_SSID
        string "Router SSID"
        default "ROUTER_SSID"
        help
            Router SSID.

    config MESH_ROUTER_PASSWD
        string "Router password"
        default "ROUTER_PASSWD"
        help
            Router password.

    choice
        bool "Mesh AP Authentication Mode"
        default WIFI_AUTH_WPA2_PSK
        help
            Authentication mode.

        config WIFI_AUTH_OPEN
            bool "WIFI_AUTH_OPEN"
        config WIFI_AUTH_WPA_PSK
            bool "WIFI_AUTH_WPA_PSK"
        config WIFI_AUTH_WPA2_PSK
            bool "WIFI_AUTH_WPA2_PSK"
        config WIFI_AUTH_WPA_WPA2_PSK
            bool "WIFI_AUTH_WPA_WPA2_PSK"
    endchoice

    config MESH_AP_AUTHMODE
        int
        default 0 if WIFI_AUTH_OPEN
        default 2 if WIFI_AUTH_WPA_PSK
        default 3 if WIFI_AUTH_WPA2_PSK
        default 4 if WIFI_AUTH_WPA_WPA2_PSK
        help
            Mesh AP authentication mode.

    config MESH_AP_PASSWD
        string "Mesh AP Password"
        default "MAP_PASSWD"
        help
            Mesh AP password.

    config MESH_AP_CONNECTIONS
        int "Mesh AP Connections"
        range 1 10
        default 6
        help
            The number of mesh stations allowed to connect in.

    config MESH_NON_MESH_AP_CONNECTIONS
        int "Mesh Non Mesh AP Connections"
        range 0 9
        default 0
        help
            The number of non-mesh stations allowed to connect in.

    config MESH_ROUTE_TABLE_SIZE
        int "Mesh Routing Table Size"
        range 1 300
        default 50
        help
            The number of devices over the network(max: 300).
    choice MESH_DEVICE_TYPE_CHOICE
        prompt "Mesh node product type"
        default MESH_DEVICE_TYPE_LIGHT_BULB
        help
            Product type published by this node. All current profiles use the
            same on/off mesh command; the board LED acts as the demo output.

        config MESH_DEVICE_TYPE_LIGHT_BULB
            bool "Smart light bulb"
        config MESH_DEVICE_TYPE_CEILING_LIGHT
            bool "Ceiling light"
        config MESH_DEVICE_TYPE_LIGHT_STRIP
            bool "Light strip"
        config MESH_DEVICE_TYPE_WALL_SWITCH
            bool "Wall switch"
        config MESH_DEVICE_TYPE_SOCKET
            bool "Smart socket"
        config MESH_DEVICE_TYPE_RELAY
            bool "Relay / generic controller"
        config MESH_DEVICE_TYPE_CURTAIN_MOTOR
            bool "Curtain motor"
        config MESH_DEVICE_TYPE_VALVE
            bool "Valve actuator"
        config MESH_DEVICE_TYPE_DOOR_LOCK
            bool "Smart door lock"
    endchoice

    config MESH_DEVICE_TYPE
        string
        default "light_bulb" if MESH_DEVICE_TYPE_LIGHT_BULB
        default "ceiling_light" if MESH_DEVICE_TYPE_CEILING_LIGHT
        default "light_strip" if MESH_DEVICE_TYPE_LIGHT_STRIP
        default "wall_switch" if MESH_DEVICE_TYPE_WALL_SWITCH
        default "socket" if MESH_DEVICE_TYPE_SOCKET
        default "relay" if MESH_DEVICE_TYPE_RELAY
        default "curtain_motor" if MESH_DEVICE_TYPE_CURTAIN_MOTOR
        default "valve" if MESH_DEVICE_TYPE_VALVE
        default "door_lock" if MESH_DEVICE_TYPE_DOOR_LOCK

    config MESH_GATEWAY_PROVISIONING
        bool "Enable BLE WiFi provisioning for this gateway build"
        default n
        help
            Enable only for the dedicated gateway/root firmware profile. Mesh nodes
            retain their automatic join behavior and do not start a provisioning service.

    config MESH_PROV_NAME_PREFIX
        string "Gateway provisioning device name prefix"
        depends on MESH_GATEWAY_PROVISIONING
        default "Gateway-"

    config MESH_PROV_POP
        string "Gateway provisioning proof-of-possession"
        depends on MESH_GATEWAY_PROVISIONING
        default "gateway1234"

    config MESH_PROV_RESET_GPIO
        int "Gateway provisioning reset GPIO"
        depends on MESH_GATEWAY_PROVISIONING
        range 0 48
        default 0
        help
            Hold this active-low button for three seconds while running to erase
            stored router credentials and restart BLE provisioning.

endmenu
```

## internal_communication/sdkconfig.defaults.esp32s3
```kconfig
# ESP32-S3-N16R8 (Mesh gateway/root) build overrides
CONFIG_ESPTOOLPY_FLASHSIZE_16MB=y
CONFIG_ESPTOOLPY_FLASHSIZE="16MB"
CONFIG_PARTITION_TABLE_SINGLE_APP_LARGE=y
```

## rgb_light/main/Kconfig.projbuild
```kconfig
menu "RGB Light Configuration"

    choice EXAMPLE_PROV_TRANSPORT
        prompt "WiFi provisioning transport"
        default EXAMPLE_PROV_TRANSPORT_BLE

        config EXAMPLE_PROV_TRANSPORT_BLE
            bool "BLE (recommended)"

        config EXAMPLE_PROV_TRANSPORT_SOFTAP
            bool "SoftAP compatibility mode"
    endchoice

    config EXAMPLE_PROV_SOFTAP_PREFIX
        string "Provisioning device name prefix"
        default "Light-"
        help
            The BLE advertisement or SoftAP name is built as
            "<prefix><last 3 MAC bytes>", e.g. Light-4C3408.

    config EXAMPLE_PROV_POP
        string "Provisioning proof-of-possession"
        default "light1234"

    config EXAMPLE_MQTT_BROKER_URI
        string "MQTT broker URI"
        default "mqtt://121.40.131.194:1883"

    config EXAMPLE_MQTT_USERNAME
        string "MQTT username"
        default "yskj"

    config EXAMPLE_MQTT_PASSWORD
        string "MQTT password"
        default "yskj@123"

    config EXAMPLE_LIGHT_GPIO
        int "WS2812 RGB LED GPIO"
        default 48
        range 0 48
        help
            Data pin of the onboard WS2812 LED (GPIO48 on most ESP32-S3
            N16R8 devkits; some boards use GPIO38).

    config EXAMPLE_LIGHT_LED_COUNT
        int "Number of WS2812 LEDs"
        default 1
        range 1 64

    config EXAMPLE_ENABLE_COLOR
        bool "Enable RGB color commands"
        default y
        help
            When disabled the light only supports on/off (used to build the
            baseline 1.0.0 firmware for the OTA end-to-end test).

    config EXAMPLE_PRODUCT_ID
        string "OTA product id"
        default "farmely-rgb-light"

    config EXAMPLE_HW_VERSION
        string "OTA hardware version"
        default "s3-n16r8"

endmenu
```

## sdkconfig.defaults
```kconfig
CONFIG_COMPILER_OPTIMIZATION_SIZE=y
CONFIG_MESH_ROUTER_SSID="Xiaomi"
CONFIG_MESH_ROUTER_PASSWD="2684495783"
```
